## Kconfig
```kconfig
DT_COMPAT_ZMK_BEHAVIOR_ANTECEDENT_MORTH := zmk,behavior-antecedent-morph

config ZMK_BEHAVIOR_ANTECEDENT_MORPH
    bool
    default $(dt_compat_enabled,$(DT_COMPAT_ZMK_BEHAVIOR_ANTECEDENT_MORPH))

config ZMK_ANTECEDENT_MORPH_DISCARD_DEAD_ANTECEDENTS
    bool "Drop dead antecedent keys once they were catched."
    default y
```
